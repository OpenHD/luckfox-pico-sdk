## sysdrv/tools/board/buildroot/luckfox_pico_nand_defconfig
```kconfig
BR2_arm=y
BR2_cortex_a7=y
BR2_TOOLCHAIN_EXTERNAL=y
BR2_TOOLCHAIN_EXTERNAL_CUSTOM=y
BR2_TOOLCHAIN_EXTERNAL_PATH="../../../../tools/linux/toolchain/arm-rockchip830-linux-uclibcgnueabihf"
BR2_TOOLCHAIN_EXTERNAL_CUSTOM_PREFIX="arm-rockchip830-linux-uclibcgnueabihf"
BR2_TOOLCHAIN_EXTERNAL_GCC_8=y
BR2_TOOLCHAIN_EXTERNAL_HEADERS_5_10=y
BR2_TOOLCHAIN_EXTERNAL_WCHAR=y
BR2_TOOLCHAIN_EXTERNAL_HAS_SSP=y
BR2_TOOLCHAIN_EXTERNAL_CXX=y
BR2_PRIMARY_SITE="https://sources.buildroot.net"
BR2_OPTIMIZE_S=y
BR2_STRIP_strip=y
BR2_TARGET_GENERIC_HOSTNAME="openhd-pico-nand"
BR2_TARGET_GENERIC_ROOT_PASSWD="luckfox"
BR2_SYSTEM_DHCP="eth0"
BR2_PACKAGE_OPENSSH=y
BR2_PACKAGE_BASH=y
BR2_PACKAGE_IW=y
BR2_PACKAGE_LIBUSB=y
BR2_PACKAGE_MTD=y
BR2_PACKAGE_ANDROID_TOOLS=y
BR2_PACKAGE_ANDROID_TOOLS_ADBD=y
BR2_PACKAGE_HOST_DTC=y
BR2_PACKAGE_HOST_ENVIRONMENT_SETUP=y
```

## sysdrv/tools/board/buildroot/package/OpenHD-SysUtils/Config.in
```kconfig
config BR2_PACKAGE_OPENHD_SYSUTILS
    bool "openhd-sysutils"
    select BR2_PACKAGE_LIBUSB
    select BR2_PACKAGE_USB_MODESWITCH
    select BR2_PACKAGE_UTIL_LINUX
    select BR2_PACKAGE_UTIL_LINUX_BINARIES
    help
      OpenHD-SysUtils package
```

## sysdrv/tools/board/buildroot/package/OpenHD/Config.in
```kconfig
config BR2_PACKAGE_OPENHD
    bool "openhd"
    select BR2_PACKAGE_LIBPCAP
    select BR2_PACKAGE_LIBUSB
    select BR2_PACKAGE_LIBRTLSDR
    select BR2_PACKAGE_NCURSES
    select BR2_PACKAGE_PYTHON3
    select BR2_PACKAGE_LIBSODIUM
    select BR2_PACKAGE_GSTREAMER1
    select BR2_PACKAGE_GST1_PLUGINS_BASE
    select BR2_PACKAGE_GST1_PLUGINS_BASE_PLUGIN_APP
    select BR2_PACKAGE_OPENHD_SYSUTILS
    help
      OpenHD package
```
